## yocto/meta-lorawan-gateway-health/conf/layer.conf
```bitbake
# UNVERIFIED: never built with BitBake.
BBPATH .= ":${LAYERDIR}"
BBFILES += "${LAYERDIR}/recipes-*/*/*.bb ${LAYERDIR}/recipes-*/*/*.bbappend"

BBFILE_COLLECTIONS += "lorawan-gateway-health"
BBFILE_PATTERN_lorawan-gateway-health = "^${LAYERDIR}/"
BBFILE_PRIORITY_lorawan-gateway-health = "10"

# Adjust to the release series your image uses.
LAYERSERIES_COMPAT_lorawan-gateway-health = "scarthgap"
LAYERDEPENDS_lorawan-gateway-health = "core"
```
